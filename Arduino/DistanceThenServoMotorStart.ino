#include <Servo.h>

Servo myservo;
int pos = 0;

long sure;
long uzaklik;
int trigPin = 7;
int echoPin = 6;
bool acikMi = false;

void setup() {
  pinMode(trigPin, OUTPUT);
  pinMode(echoPin, INPUT);
  Serial.begin(9600);

  myservo.attach(9);
  myservo.write(0);
}

void loop() {


  delay(500);

  digitalWrite(trigPin, LOW);
  delayMicroseconds(5);
  digitalWrite(trigPin, HIGH);
  delayMicroseconds(10);
  digitalWrite(trigPin, LOW);
  sure = pulseIn(echoPin, HIGH);
  uzaklik = sure / 29.1 / 2;
  if (uzaklik > 200)
    uzaklik = 200;
  Serial.print(" Uzaklik: ");
  Serial.print(uzaklik);

  Serial.print(" acikMi: ");
  Serial.print(acikMi ? "evet" : "hayir");

  Serial.print(" Pos: ");
  Serial.print(pos);

  Serial.println("");


  if (acikMi == false && uzaklik <= 15) {
    for (pos = 0; pos <= 160; pos += 1) {
      myservo.write(pos);
      delay(15);
      Serial.print(" Ac: ");
      Serial.println(pos);
    }
    acikMi = true;
  } else if (acikMi == true && uzaklik > 15) {
    for (pos = 160; pos >= 0; pos -= 1) {
      myservo.write(pos);
      delay(15);
      Serial.print(" Kapat: ");
      Serial.println(pos);
    }
    acikMi = false;
  }

}
